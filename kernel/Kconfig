## kernel/Kconfig
```kconfig
menu "Build & Debugging"

choice
	prompt "Optimization level"
	default CC_OPTIMIZE_O0

config CC_OPTIMIZE_O0
	bool "-O0"

config CC_OPTIMIZE_O1
	bool "-O1"

config CC_OPTIMIZE_OG
	bool "-Og"

config CC_OPTIMIZE_O2
	bool "-O2"

config CC_OPTIMIZE_O3
	bool "-O3"

config CC_OPTIMIZE_OZ
	bool "-Oz"

config CC_OPTIMIZE_OS
	bool "-Os"

endchoice

config GC_SECTIONS
	bool "Garbage collect unused sections"
	default y if !CC_OPTIMIZE_O0
	default n if CC_OPTIMIZE_O0
	help
	  Place functions and data into separate sections and ask the linker to
	  drop unreferenced sections from the final kernel image.

config LTO
	bool "Link-time optimization"
	default n

config FRAME_POINTER
	bool "Frame pointer"
	default y


config DEBUG_INFO
	bool "Debug information"
	default y

config DEBUG_CONTEXT
	bool "CPU context and spinlock tracking"
	default n
	help
	  Keep per-CPU held-spinlock addresses for context diagnostics. This
	  enables membership, recursive-lock, and lock-capacity checks while
	  the lock depth and any-held query remain available in every build.

config UBSAN
	bool "Undefined behavior sanitizer"
	default n
	help
	  Enable kernel-side undefined behavior sanitizer trap instrumentation.

config KSYMS
	bool "Kernel symbol lookup table"
	depends on !LTO
	default y

endmenu
```
