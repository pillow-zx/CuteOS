## Kconfig
```kconfig
mainmenu "cuteOS Configuration"

menu "General setup"

comment "cuteOS uses a single .config in the repository root."

endmenu

source "kernel/Kconfig"
source "arch/riscv/Kconfig"
source "fs/Kconfig"
```

## arch/riscv/Kconfig
```kconfig
menu "Platform"

config ARCH_RISCV
	bool
	default y

config PLATFORM_QEMU_VIRT
	bool
	default y

comment "QEMU virt is the only supported platform in this stage."

config DRAM_SIZE_MB
	int "DRAM size (MiB)"
	range 64 1024
	default 256
	help
	  Current early boot page tables cover the 1 GiB window starting at
	  DRAM_BASE, so larger memory sizes require boot mapping changes.

config QEMU_CPUS
	int "QEMU CPU count"
	range 1 8
	default 1
	help
	  This controls QEMU -smp only. The kernel still boots hart 0 only.

endmenu
```

## configs/cuteos_defconfig
```kconfig
CONFIG_ARCH_RISCV=y
CONFIG_PLATFORM_QEMU_VIRT=y
CONFIG_DRAM_SIZE_MB=256
CONFIG_QEMU_CPUS=1
CONFIG_EXT2_FS=y
CONFIG_ROOTFS_IMAGE_SIZE_MB=16
CONFIG_CC_OPTIMIZE_O2=y
CONFIG_GC_SECTIONS=y
CONFIG_FRAME_POINTER=y
# CONFIG_LTO is not set
# CONFIG_DEBUG_INFO is not set
# CONFIG_UBSAN is not set
# CONFIG_KSYMS is not set
```

## configs/cuteos_release_defconfig
```kconfig
CONFIG_ARCH_RISCV=y
CONFIG_PLATFORM_QEMU_VIRT=y
CONFIG_DRAM_SIZE_MB=256
CONFIG_QEMU_CPUS=1
CONFIG_EXT2_FS=y
CONFIG_ROOTFS_IMAGE_SIZE_MB=16
CONFIG_CC_OPTIMIZE_O2=y
CONFIG_GC_SECTIONS=y
CONFIG_LTO=y
# CONFIG_DEBUG_INFO is not set
# CONFIG_FRAME_POINTER is not set
# CONFIG_UBSAN is not set
# CONFIG_KSYMS is not set
```

## fs/Kconfig
```kconfig
menu "File systems"

config EXT2_FS
	bool
	default y

config ROOTFS_IMAGE_SIZE_MB
	int "Root filesystem image size (MiB)"
	range 8 256
	default 16

endmenu
```

## user/Kconfig
```kconfig
menu "User space"

choice
	prompt "User-space profile"
	default USERSPACE_MINIMAL

config USERSPACE_MINIMAL
	bool "Minimal libc user space"
	help
	  Build the project init, shell, commands, and ABI test programs with
	  the project minimal libc.

config USERSPACE_BUSYBOX
	bool "BusyBox user space (musl)"
	select USER_LIBC_MUSL
	select USER_BUSYBOX
	help
	  Keep the project minimal-libc init as PID 1 and use a static musl
	  BusyBox for /bin/sh and user commands.

endchoice

config USER_LIBC_MUSL
	bool

config USER_BUSYBOX
	bool
	depends on USER_LIBC_MUSL

endmenu
```
